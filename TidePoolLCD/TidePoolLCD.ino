/*
  Tide Pool

  This program will take the inputs from two switches and control indicator
  lights as well as pumps.  We want to have the time between low and high tide
  roughly 6.5 hours.  We don't know exactly how long it will take the little
  pumps to fill or drain.  So we will cycle them on/off and record the final time
  and then stay at high or low tide until 6.5 hours is reached.

  You can change the default of whether the tide is rising when the microcontroller
  first initializes.

  The goal is to simulate a tidal cycle (~13 hours)

  Inputs ---
  Pin 2: Lower switch +5V means water is too low
  Pin 3: High switch +5V means water is too high

  Pin 8: Reference (+5 V)

  Outputs ---
  Pin 09: Blue LED turn on when high switch is selected
  Pint 10: Green LED turn on when low switch is selected

  Pin 11: Relay IN2 = Left switch with infow pump (raising)
  Pin 12: Relay IN1 = Right switch with outflow pump (lowering)


  Author: Steve Lindaas - based on circuit and original program idea by Ben LeMay
  Version 1.0 April 9 2018
  Additional Author: Paige Meyer
  Version 1.3 April 10 2018
*/

#include <Wire.h>
#include "rgb_lcd.h"

rgb_lcd lcd;

boolean start;

// Pin constants won't change.

// high and low bobbers
const int InHigh =  3;
const int InLow  =  2;

// ultrasonic sensor pins
const int triggerPin = 6;
const int echoPin = 7;

// reference voltage
const int InRef  = 8;

// LEDs to show on or off
const int HighLED = 9;
const int LowLED  = 10;

// NOTE: Don't have any on pin 13 as this pin goes high when reset
const int PumpFill = 11;    // This pump fills the pool
const int PumpDrain = 12;   // This pump empties the pool

// Generally, use "unsigned long" for variables that hold time
// since the value will quickly become too large for an int to store
unsigned long startTime = 0;                        // store the tide half-cycle starting time
unsigned long previousTime = 0;                     // store the time since the pump was either turned on or off.

const unsigned long TideInterval = 6.5 * 60 * 60 * 1000;  // 6.5 hours is the half-period of a tide (in msec)
const unsigned long pumpOnTime = 5.0 * 60 * 1000;           // Pump is ON for 5 minutes
const unsigned long pumpOffTime = 5.0 * 60 * 1000;          // Pump is OFF for 5 minutes
const unsigned long extremeTideTime = 1.0 * 60 * 1000;

// Tide state variables
boolean HighTide = false;          // Default lowering tide when you first turn on the system
boolean LowTide = true;
boolean Rising = true;
boolean PumpOn = false;

// variables to write about pump on
int writePumpOn = LOW;     // When pump is on, write low
int writePumpOff = HIGH;   // When pump is off, write high

// Sensor varialbles - Initially set all the switches LOW (not tripped)
int sensorHigh = LOW;
int sensorLow = LOW;
int sensorRef = LOW;
// Set the last sensor states
int lastSensorHigh = sensorHigh;
int lastSensorLow = sensorLow;
int lastSensorRef = sensorRef;
unsigned long lastTimeHigh = 0;
unsigned long lastTimeLow = 0;
unsigned long lastTimeRef = 0;
unsigned long debounceDelay = 100;

// Indicator light variables
unsigned long timeLED = 0;
int stateLED = LOW;             // ledState used to set the LED
long blinkLED = 500;           // interval at which to blink (milliseconds)
const long blinkFast = 150;
const long blinkSlow = 1000;

// Tidal Level Data
int currentTideIndex = 0;           // current index in tideLevels
const int tideLevelLength = 7471;   // lenght of tide Level array
// const int timeBetween = 6 * 60 * 1000; // 6 minute tidal level interval
// const short tideLevels[] = {-0.01, -0.02, -0.02, -0.03, -0.03, -0.03, -0.03, -0.03, -0.03, -0.03, -0.02, -0.02, -0.01,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 -0.02, -0.01};

// Run initial setup of variables
void setup() {
  // Start serial connection so that we can print to the LCD screen for testing
  Serial.begin(115200);

  lcd.begin(16, 2);     // set up the LCD's number of columns and rows
  lcd.setRGB(0, 255, 0); // make lcd green initially

  // Set the various digital input pins
  pinMode( InHigh, INPUT );
  pinMode( InLow, INPUT );
  pinMode( InRef, INPUT );

  // Set the various digital output pins
  pinMode( HighLED, OUTPUT );
  pinMode( LowLED, OUTPUT );
  pinMode( PumpFill, OUTPUT );      // When a pump is LOW pump on
  pinMode( PumpDrain, OUTPUT );
  start = true;

  dumpState("");              // print current state

  currentTideIndex = 0;   // ensure start at the first tide level;
}

// Main program
void loop() {

  // Read the current time... everything is testing time intervals.
  unsigned long currentTime = millis();

  // If you are at High or Low tide you need to wait until the tide interval is complete.  The time has to reach
  // the end of the TideInterval.

  // initializes variables at the start of a rising or falling tide
  if ( (currentTime - startTime) >= TideInterval || start ) {
    // turn both pumps off initially
    // and every single time change tide, turn off both pumps, will be turn on/off later in code
    digitalWrite( PumpFill, writePumpOff);
    digitalWrite( PumpDrain, writePumpOff);

    start = false;          // start variable makes sure this loop is executed at the beginning when t=0

    if ( Rising ) {         // Possibly the high and low tide sensor switches never get
      Rising = false;       // triggered in the TideInteval (testing situation)
    } else {
      Rising = true;
    }

    if ( HighTide ) {
      HighTide = false;
      Rising = false;
    } else if ( LowTide ) {
      LowTide = false;
      Rising = true;
    }

    startTime = currentTime;  // Reset the start of the tide cycle
    previousTime = currentTime;

    PumpOn = true;            // Turn the pump on to either raise or lower the tide
    blinkLED = blinkFast;

    // update LCD Screen
    if (Rising) {
      setStateMessage("TidePool Drained");
      dumpState("TidePool Drained");
    }
    else {
      setStateMessage("Tide Pool Full");
      dumpState("Tide Pool Full");
    }
    if (sensorHigh) {
      setSensorMessage("High Water!");
    }
    else if (sensorLow) {
      setSensorMessage("Low Water!");
    }
  }

  // Now we need to check our sensors.... but make sure to debounce the readings
  //
  int readingSensorHigh = digitalRead(InHigh);
  int readingSensorLow = digitalRead(InLow);
  int readingSensorRef = digitalRead(InRef);

  // Check to see if the switches changed state due to either noise or water level
  //
  if ( readingSensorHigh != lastSensorHigh ) {
    // Set the time and then we will will wait to see if the state change is stable
    lastTimeHigh = currentTime;
  }
  // If enough time has passed then the sensor is not fluctuating
  if ( (currentTime - lastTimeHigh) > debounceDelay ) {
    if ( readingSensorHigh != sensorHigh ) {
      sensorHigh = readingSensorHigh;
      // If Sensor reading switched than print out an update
      if (sensorHigh) {
        setSensorMessage("High Water!");
      }
      else {
        setSensorMessage("");
      }
    }
  }
  lastSensorHigh = readingSensorHigh;

  if ( readingSensorLow != lastSensorLow ) {
    // Set the time and then we will will wait to see if the state change is stable
    lastTimeLow = currentTime;
  }
  // If enough time has passed then the sensor is not fluctuating
  if ( (currentTime - lastTimeLow) > debounceDelay ) {
    if ( readingSensorLow != sensorLow ) {
      sensorLow = readingSensorLow;
      // If Sensor reading switched then print out an update

      if (sensorLow) {
        setSensorMessage("Low Water!");
      }
      else {
        setSensorMessage("");
      }
    }
  }
  lastSensorLow = readingSensorLow;

  if ( readingSensorRef != lastSensorRef ) {
    // Set the time and then we will will wait to see if the state change is stable
    lastTimeRef = currentTime;
  }
  // If enough time has passed then the sensor is not fluctuating
  if ( (currentTime - lastTimeRef) > debounceDelay ) {
    if ( readingSensorRef != sensorRef ) {
      sensorRef = readingSensorRef;
      // If Sensor reading switched than print out an update
      Serial.print("Reference Sensor = ");
      Serial.println(sensorRef);
    }
  }
  lastSensorRef = readingSensorRef;

  /*
      Add a user programming feature here where you could action based on both triggers set.
      Could enter program mode with input set by toggling switches.

      Not implemented yet...
  */

  // Set the HighTide or LowTide boolean values and then turn off the appropriate pump
  // Indicator light: solid LED if a sensor is set, blink the HighLED if you are Rising
  // and blink the LowLED if you are not Rising
  //
  if ( sensorHigh == HIGH ) {
    HighTide = true;
    digitalWrite( HighLED, HIGH);
    // make sure pump has been on for at least a minute
    if ((currentTime - previousTime) >= extremeTideTime && Rising) {
      // Turn the PumpFill off since we want to stop filling the pool
      digitalWrite( PumpFill, writePumpOff);

      PumpOn = false;
      previousTime = currentTime;
    }

  } else {
    HighTide = false;
    digitalWrite( HighLED, LOW);
  }

  if (sensorLow == HIGH) {
    LowTide = true;
    digitalWrite( LowLED, HIGH);
    if ((currentTime - previousTime) >= extremeTideTime && !Rising) {
      // Turn the PumpDrain off since we want to stop draining the pool
      digitalWrite( PumpDrain, writePumpOff);
      PumpOn = false;
      previousTime = currentTime;
    }
  } else {
    LowTide = false;
    digitalWrite( LowLED, LOW);
  }

  // if both the low sensor and high sensor are tripped, we have an error
  if (sensorLow == HIGH and sensorHigh == HIGH) {
    setErrorMessage("SENSOR ERROR");
  }

  // Blink the indicator LED if it is not high or low tide
  if ( !HighTide && !LowTide ) {
    if ( (currentTime - timeLED) >= blinkLED ) {
      // if the LED is off turn it on and vice-versa:
      if ( stateLED == LOW) {
        stateLED = HIGH;
      } else {
        stateLED = LOW;
      }
      timeLED = currentTime;
    }
    if ( Rising ) {
      digitalWrite( HighLED, stateLED);
    } else {
      digitalWrite( LowLED, stateLED);
    }
  }


  /*
      Need to wait until the High or Low tide time interval has been met. Then start a pump.
      We want to cycle the correct pump on and off with the cycle time.

      PumpFill fills the pool
      PumpDrain empties the pool
  */

  if ( Rising && !HighTide ) {
    if ( PumpOn && (currentTime - previousTime) >= pumpOnTime ) {
      PumpOn = false;
      blinkLED = blinkSlow;
      previousTime = currentTime;

      setStateMessage("Pause Filling Tide Pool");
    } else if ( !PumpOn && (currentTime - previousTime) >= pumpOffTime ) {
      PumpOn = true;
      blinkLED = blinkFast;
      previousTime = currentTime;

      // print if is filling
      setStateMessage("Filling Tide Pool");
    }

    if ( PumpOn ) {
      // Pump stays on for the pumpOnTime
      digitalWrite( PumpFill, writePumpOn);
    } else {
      // Pump stays off for the pumpOffTime
      digitalWrite( PumpFill, writePumpOff);
    }
  }

  if ( !Rising && !LowTide ) {
    if ( PumpOn && (currentTime - previousTime) >= pumpOnTime ) {
      PumpOn = false;
      blinkLED = blinkSlow;
      previousTime = currentTime;

      // print if paused draining
      setStateMessage("Pause Draining Tide Pool");
    } else if ( !PumpOn && (currentTime - previousTime) >= pumpOffTime ) {
      PumpOn = true;
      blinkLED = blinkFast;
      previousTime = currentTime;

      // print if is draining
      setStateMessage("Draining Tide Pool");
    }

    if ( PumpOn ) {
      // Pump stays on for the pumpOnTime
      digitalWrite(PumpDrain, writePumpOn);
    } else {
      // Pump stays off for the pumpOffTime
      digitalWrite(PumpDrain, writePumpOff);
    }
  }
}
// End of void() loop

float tideShouldBe(float tideData) {
  /* Returns what our representative tidal level should be.
    In our model, the tidal data ranges from 0-0.433 meters (0-17 inches)
    If the tidal data is out of that range, it returns the maximum or minimum
    level
  */
  const float MAXTIDE = 0.44;
  const float MINTIDE = 0;

  if (tideData < MINTIDE) {
    return MINTIDE;
  }
  else if (tideData > MAXTIDE) {
    return MAXTIDE;
  }
  else {
    return tideData;
  }
} // end tideShouldBe

float currentLevel() {
  /* Returns the current tide Level is in meters*/
  float duration, distance;
  digitalWrite(triggerPin, LOW);
  digitalWrite(triggerPin, HIGH);
  digitalWrite(triggerPin, LOW);
  duration = pulseIn(echoPin, HIGH);
  distance = (duration / 5820);    // Change time to get pulse back to centimeters
  return distance;
}

void setStateMessage(String msg) {
  /* Function to print state message on first row of LCD and to Serial Montior */
  lcd.setCursor(0, 0);        // put on first row, first space
  printToLCD(msg);

  Serial.print("State Update: ");
  Serial.println(msg);
}

void setErrorMessage(String msg) {

  /* Function to print error message on second row of LCD */
  lcd.setCursor(0, 1);        // put on second row, first space
  if (msg != "" || msg != " ") {
    lcd.setRGB(255, 0, 0);
    printToLCD(msg);
  }

  Serial.print("Error Update: ");
  Serial.println(msg);
}

void setSensorMessage(String msg) {
  /* Function to print sensor message on second row of LCD  and to Serial Montior*/
  
  lcd.setCursor(0, 1);        // put on second row, first space
  if (msg == "" || msg == " ") {
    lcd.setRGB(0, 255, 0);
  }
  else {
    lcd.setRGB(0, 0, 255);
  }
  printToLCD(msg);

  
  Serial.print("Sensor update: ");
  Serial.println(msg);
}

void printToLCD(String msg) {
  /* Prints message to LCD overwriting everything else in the row based on
    current cursor position. Note, don't need spaces at end of message.
  */
  lcd.print(msg);
  // pad remaining with spaces as to overwrite old message
  int len = msg.length();
  for (int i = 0; i < (16 - len); i++)
    lcd.print(' ');
}

void dumpState(String msg) {
  /* Prints state to serial monitor */
  // ensure these are correct
  Serial.print("TideInterval ");
  Serial.println(TideInterval);
  Serial.print("PumpOnTime ");
  Serial.println(pumpOnTime);
  Serial.print("PumpOffTime ");
  Serial.println(pumpOffTime);
  Serial.print("ExtremeTideTime ");
  Serial.println(extremeTideTime);

  Serial.println(msg);
  Serial.print("The variable Rising is ");
  Serial.println( Rising );
  Serial.print("   FYI: High Water Sensor = ");
  Serial.println(sensorHigh);
  Serial.print("   FYI: Low Water Sensor = ");
  Serial.println(sensorLow);
  Serial.print("   FYI: Reference Sensor = ");
  Serial.println(sensorRef);
  Serial.println();
}
